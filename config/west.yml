## config/west.yml
```yaml
manifest:
  remotes:
    - name: zmkfirmware_pj
      url-base: https://github.com/petejohanson
    - name: inorichi
      url-base: https://github.com/inorichi
    - name: urob
      url-base: https://github.com/urob
    - name: yg2chen
      url-base: https://github.com/yg2chen
  projects:
    - name: zmk
      remote: zmkfirmware_pj
      revision: feat/pointers-move-scroll
      import: app/west.yml
    - name: zmk-pmw3610-driver
      remote: inorichi
      revision: main
    - name: zmk-auto-layer
      remote: yg2chen
      revision: main
  self:
    path: config
```
